## arch/arm/mach-fsm/Kconfig
```kconfig
if ARCH_FSM

choice
	prompt "FSM SoC Type"

config ARCH_FSM9XXX
	bool "FSM9XXX"
	select ARCH_MSM_SCORPION
	select MSM_VIC
	select CPU_V7
	select MSM_REMOTE_SPINLOCK_DEKKERS
	select FSM9XXX_TLMM

endchoice

menu "FSM Board Selection"

config MACH_FSM9XXX_SURF
       depends on ARCH_FSM9XXX
       depends on !MSM_STACKED_MEMORY
       default y
       bool "FSM9XXX SURF"
       help
         Support for the Qualcomm FSM9XXX SURF eval board.

endmenu

config PHYS_OFFSET
	hex
	default "0x04800000" if ARCH_FSM9XXX && !MSM_STACKED_MEMORY
endif


config FSM9XXX_TLMM
       bool
```

## drivers/i2c/chips/Kconfig
```kconfig
#
# Miscellaneous I2C chip drivers configuration
#
# *** DEPRECATED! Do not add new entries! See Makefile ***
#

menu "Miscellaneous I2C Chip support"

# +++ FIH_FXX +++, Neo Chen, 2009/06/08, change backlight driver from max7302 to max8831
config BACKLIGHT_LED_MAX8831
        tristate "Max8831 backlight controller"
        depends on I2C=y && ARCH_MSM
        help
# --- FIH_FXX ---, Neo Chen, 2009/06/08,

# +++ FIH_FXX +++, Charles Huang, 2009/05/18
config FLASH_DRIVER_IC_AAT1272
        tristate "AAT1272 flash driver ic"
        depends on I2C=y && ARCH_MSM
        help
# --- FIH_FXX ---, Charles Huang, 2009/05/18

config BACKLIGHT_LED_TCA6507
        tristate "TCA6507 backlight led controller"
        depends on I2C=y && ARCH_MSM
        help

endmenu
```

## drivers/input/ecompass/Kconfig
```kconfig
#
# Input misc drivers configuration
#
menuconfig INPUT_ECOMPASS
	bool "E-Compass devices"
	help
	  Say Y here, and a list of sensors input drivers will be displayed.
	  Everything that didn't fit into the other categories is here. This option
	  doesn't affect the kernel.

	  If unsure, say N.

if INPUT_ECOMPASS
menuconfig FIH_ECOMPASS_SENSOR
	tristate "FIH E-Compass sensor controller"
	default y
	help
		Say Y here if you want to enable FIH sensor driver.	  
endif
```

## drivers/input/lightproxisensor/Kconfig
```kconfig
#
# Input misc drivers configuration
#
menuconfig INPUT_LPSENSOR
	bool "SENSOR devices"
	help
	  Say Y here, and a list of sensors input drivers will be displayed.
	  Everything that didn't fit into the other categories is here. This option
	  doesn't affect the kernel.

	  If unsure, say Y.

if INPUT_LPSENSOR

#by WillChen 2009.05.15 FIH_Fxx
menuconfig SENSORS_LPSCM3602
	tristate "LPSCM3602 controller"
	depends on ARCH_MSM
	default y
	help
		Say Y here if you want to enable LPSENSOR PSCM3602 driver.	  
endif
```

## sound/soc/msm/Kconfig
```kconfig
menu "MSM SoC Audio support"

config SND_MSM_SOC
	tristate "SoC Audio for the MSM chip"
	depends on ARCH_MSM && SND_SOC
	select MSM_ADSP
	help
	  To add support for ALSA PCM driver for MSM board.

config SND_MSM_DAI_SOC
	tristate "SoC CPU/CODEC DAI for the MSM chip"
	depends on SND_MSM_SOC
	help
	  To add support for ALSA PCM driver for MSM board.

config SND_MSM_SOC_MSM7K
        tristate "SoC Audio support for MSM7K"
        depends on SND_MSM_SOC && SND_MSM_DAI_SOC
        help
          Say Y if you want to add support for SoC audio on msm7k
		for msm72x1 or msm7x27

config SND_QSD_SOC
	tristate "SoC Audio for the QSD chip"
	depends on ARCH_QSD && SND_SOC && QSD_AUDIO
	default y
	help
	  To add support for ALSA PCM driver for QSD8k board.

endmenu
```
